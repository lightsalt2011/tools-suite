title "./out"
sys.cpu CORTEXA7
sys.up
data.load.binary DDRCS0.BIN 0x80000000
data.load.binary DDRCS1.BIN 0xc0000000
data.load.binary OCIMEM.BIN 0x8600000
PER.S.F C15:0x2 %L 0x80004000
mmu.on
mmu.scan
data.load.elf vmlinux /nocode


task.config C:\T32\demo\arm64\kernel\linux\linux-3.x\linux3.t32
menu.reprogram C:\T32\demo\arm64\kernel\linux\linux-3.x\linux.men

task.dtask
v.v  %ASCII %STRING linux_banner
do ./out/regs_panic.cmm
