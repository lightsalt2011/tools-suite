title "./AP_logs"
sys.cpu CortexA57A53
sys.up
data.load.binary DDRCS0_0.BIN 0x0
data.load.binary DDRCS0_1.BIN 0x40000000
data.load.binary DDRCS1_0.BIN 0x20000000
data.load.binary DDRCS1_1.BIN 0x60000000
data.load.binary OCIMEM.BIN 0xfe800000
Register.Set NS 1
Data.Set SPR:0x30201 %Quad 0x000000000007D000
Data.Set SPR:0x30202 %Quad 0x00000032B5193519
Data.Set SPR:0x30A20 %Quad 0x000000FF440C0400
Data.Set SPR:0x30A30 %Quad 0x0000000000000000
Data.Set SPR:0x30100 %Quad 0x0000000004C5D93D
Register.Set CPSR 0x3C5	
MMU.Delete
MMU.SCAN PT 0xFFFFFF8000000000--0xFFFFFFFFFFFFFFFF
mmu.on
mmu.pt.list 0xffffff8000000000
data.load.elf vmlinux /nocode
task.config C:\T32\demo\arm64\kernel\linux\linux-3.x\linux3.t32
menu.reprogram C:\T32\demo\arm64\kernel\linux\linux-3.x\linux.men

task.dtask
v.v  %ASCII %STRING linux_banner
do 	AP_logs\core0_regs.cmm
